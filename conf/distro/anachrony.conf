## conf/distro/anachrony.conf
```bitbake
# Copyright (C) 2024 Julia "JulaDDR" Nelz <julia@nelz.pl>
# Copyright (C) 2015 Florent Revest <revestflo@gmail.com>
#
# This program is free software; you can redistribute it and/or modify
# it under the terms of the GNU General Public License version 2 as
# published by the Free Software Foundation.
#
# This program is distributed in the hope that it will be useful,
# but WITHOUT ANY WARRANTY; without even the implied warranty of
# MERCHANTABILITY or FITNESS FOR A PARTICULAR PURPOSE.  See the
# GNU General Public License for more details.
#
# You should have received a copy of the GNU General Public License along
# with this program; if not, write to the Free Software Foundation, Inc.,
# 51 Franklin Street, Fifth Floor, Boston, MA 02110-1301 USA.

DISTRO = "anachrony"
DISTRO_NAME = "Anachrony"
DISTRO_VERSION ?= "0.1"

DISTRO_FEATURES = "alsa bluetooth bluez5 opengl gles gles2 pam polkit pulseaudio systemd usbhost usbgadget wayland x11 wifi xattr ${DISTRO_FEATURES_LIBC}"
DISTRO_FEATURES:remove:hybris-machine = "opengl"

DISTRO_FEATURES_NATIVE = "opengl x11"

PREFERRED_PROVIDER_jpeg = "libjpeg-turbo"
PREFERRED_PROVIDER_jpeg-native = "libjpeg-turbo-native"

PREFERRED_VERSION_geoclue = "0.12.99"

VIRTUAL-RUNTIME_init_manager = "systemd"
VIRTUAL-RUNTIME_initscripts = ""
PREFERRED_PROVIDER_udev = "systemd"

ANDROID_EXTRA_INITRAMFS_IMAGE_INSTALL ?= ""

FILESYSTEM_PERMS_TABLES = "files/fs-perms.txt files/asteroidos-fs-perms.txt files/anachrony-fs-perms.txt"

PACKAGE_FEED_URIS = "https://deb.nelz.pl/ipk"
PACKAGE_FEED_BASE_PATHS = "ipk"
PACKAGE_FEED_ARCHS = "all anthias armv7vehf-neon bass beluga catfish core2-32 dory firefish harmony hoki inharmony koi lenok minnow mooneye narwhal nemo pike qemux86 ray skipjack smelt sparrow sprat sturgeon swift tetra triggerfish wren"

SKIP_META_GNOME_SANITY_CHECK = "1"

BB_GIT_SHALLOW ?= "1"
BB_GIT_SHALLOW_DEPTH ?= "1"
BB_GENERATE_SHALLOW_TARBALLS ?= "1"

CARGO_FEATURES = "backtrace"
RUST_PANIC_STRATEGY = "abort"
```

## conf/layer.conf
```bitbake
# We have a conf and classes directory, append to BBPATH
BBPATH .= ":${LAYERDIR}"

# We have a recipes directory, add to BBFILES
BBFILES += "${LAYERDIR}/recipes*/*/*.bb ${LAYERDIR}/recipes*/*/*.bbappend"

BBFILE_COLLECTIONS += "anachrony-layer"
BBFILE_PATTERN_anachrony-layer := "^${LAYERDIR}/"
BBFILE_PRIORITY_anachrony-layer = "9"

LAYERSERIES_COMPAT_anachrony-layer = "mickledore"
LAYERDEPENDS_anachrony-layer = "core openembedded-layer asteroid-layer"

PACKAGE_FEED += "gdb strace"
```
